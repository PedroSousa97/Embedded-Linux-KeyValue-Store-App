## Buildroot Build/kvstoreapp/Config.in
```kconfig
config BR2_PACKAGE_KVSTOREAPP
	bool "kvstoreapp"
	depends on BR2_TOOLCHAIN_GCC_AT_LEAST_4_6 # C++11
	depends on BR2_PACKAGE_LEVELDB
	help
	  KVSTOREAPP is a simple key-value storage application.
	  It uses the LevelDB library to build a persistent in 
	  disk Database, that stores key-value pairs.
	  It also has built-in IPC capabilities.
```

## Buildroot Build/kvstoreclient/Config.in
```kconfig
config BR2_PACKAGE_KVSTORECLIENT
	bool "kvstoreclient"
	help
	  KVSTORECLIENT is a simple client app to interact with
	  kvstoreapp using IPC
```
